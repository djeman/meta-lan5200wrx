## conf/layer.conf
```bitbake
# We have a conf and classes directory, add to BBPATH
BBPATH .= ":${LAYERDIR}"

# We have recipes-* directories, add to BBFILES
BBFILES += "${LAYERDIR}/recipes-*/*/*.bb \
            ${LAYERDIR}/recipes-*/*/*.bbappend"

BBFILE_COLLECTIONS += "lan5200wrx"
BBFILE_PATTERN_lan5200wrx = "^${LAYERDIR}/"
BBFILE_PRIORITY_lan5200wrx = "5"
LAYERVERSION_lan5200wrx = "1"
LAYERSERIES_COMPAT_lan5200wrx = "thud"
```

## conf/machine/medianav.conf
```bitbake
#@TYPE: Machine
#@NAME: medianav
#@DESCRIPTION: medianav

require conf/machine/include/tune-mips32.inc

MACHINE_FEATURES = "bluetooth screen serial touchscreen usbhost usbgadget ext2 ext3 ext4 vfat rtc"

TARGET_ARCH = "mipsel"
DEFAULTTUNE = "mips32el-nf"

KERNEL_IMAGETYPE = "vmlinux"
KERNEL_ALT_IMAGETYPE = "vmlinux.bin"
KERNEL_IMAGE_STRIP_EXTRA_SECTIONS = ".comment"

PREFERRED_PROVIDER_virtual/kernel ?= "linux-lan5200wrx"
PREFERRED_VERSION_linux-lan5200wrx ?= "4.9%"

SERIAL_CONSOLES = "115200;ttyS2"
USE_VT ?= "0"

MACHINE_EXTRA_RRECOMMENDS = "kernel-modules"

IMAGE_FSTYPES ?= "ext4 tar.bz2"
```

## conf/machine/medianav2.conf
```bitbake
#@TYPE: Machine
#@NAME: medianav2
#@DESCRIPTION: medianav2 (evolution)

require conf/machine/include/tune-mips32.inc

TARGET_ARCH = "mipsel"

KERNEL_IMAGETYPE = "vmlinux"
KERNEL_ALT_IMAGETYPE = "vmlinux.bin"

PREFERRED_PROVIDER_virtual/kernel ?= "linux-lan5200wrx"
PREFERRED_VERSION_linux-lan5200wrx ?= "4.9%"

MACHINE_FEATURES = "screen serial touchscreen usbhost usbgadget ext2 ext3 ext4 vfat"

DISTRO_FEATURES = "${DISTRO_FEATURES_LIBC} sysvinit"

SERIAL_CONSOLES = "115200;ttyS2"

DEFAULTTUNE = "mips32el-nf"
```

## conf/machine/qemumipsmn.conf
```bitbake
#@TYPE: Machine
#@NAME: qemumips
#@DESCRIPTION: MIPS 32, Little Endian, Soft Float

require conf/machine/include/qemu.inc
require conf/machine/include/qemuboot-mips.inc
require conf/machine/include/tune-mips32.inc

KERNEL_IMAGETYPE = "vmlinux"
KERNEL_ALT_IMAGETYPE = "vmlinux.bin"

PREFERRED_PROVIDER_virtual/kernel ?= "linux-yocto"
PREFERRED_VERSION_linux-yocto ?= "4.18%"

SERIAL_CONSOLES = "115200;ttyS0"

DEFAULTTUNE = "mips32el-nf"
```
